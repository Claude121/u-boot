## board/samsung/gec210/Kconfig
```kconfig
if TARGET_S5P_GEC210

config SYS_BOARD
	default "gec210"

config SYS_VENDOR
	default "samsung"

config SYS_SOC
	default "s5pc1xx"

config SYS_CONFIG_NAME
	default "s5p_gec210"

endif
```
